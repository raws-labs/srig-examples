## CMakeLists.txt
```
cmake_minimum_required(VERSION 3.20.0)
find_package(Zephyr REQUIRED HINTS $ENV{ZEPHYR_BASE})
project(srig_shell)
target_sources(app PRIVATE src/main.c)
```

## prj.conf
```kconfig
# An interactive Zephyr shell over whatever console the board exposes to the rig.
CONFIG_SHELL=y
CONFIG_SHELL_PROMPT_UART="srig:~$ "

# The commands that make a board prove it is real: kernel version and uptime,
# the device list, and the chip's own id.
CONFIG_KERNEL_SHELL=y
CONFIG_DEVICE_SHELL=y
CONFIG_HWINFO=y
CONFIG_HWINFO_SHELL=y
CONFIG_THREAD_NAME=y
CONFIG_THREAD_MONITOR=y

CONFIG_BOOT_BANNER=y
```

## src/main.c
```c
/* A Zephyr shell that survives being a remote board.
 *
 * The shell subsystem runs on its own, so main only has to handle the one
 * thing a remote board cannot do without: getting back into a state where it
 * can be reflashed. See the board conf files for which boards need that.
 */

#include <zephyr/kernel.h>

int main(void)
{
	return 0;
}
```
